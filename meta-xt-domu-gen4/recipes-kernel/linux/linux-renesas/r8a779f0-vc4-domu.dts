/dts-v1/;

#include <dt-bindings/interrupt-controller/arm-gic.h>

/*
 * The device tree compiler (DTC) is allocating the phandle from 1 to
 * onwards. Reserve a high value for the GIC phandle.
 */
#define PHANDLE_GIC (65000)

/ {
	#address-cells = <2>;
	#size-cells = <2>;

	passthrough {
		compatible = "simple-bus";
		ranges;

		#address-cells = <2>;
		#size-cells = <2>;

		/* This must point to Xen interrupt-parent. */
		interrupt-parent = <PHANDLE_GIC>;

		rswitch {
			compatible = "renesas,etherswitch-xen";
			reg = <0 0xe68c0000 0 0x00020000>;
			interrupts = <GIC_SPI 289 IRQ_TYPE_LEVEL_HIGH>;
		};
	};
};
