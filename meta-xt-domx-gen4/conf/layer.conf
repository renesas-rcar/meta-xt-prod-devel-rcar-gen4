## meta-xt-domx-gen4/conf/layer.conf
```bitbake
# We have a conf and classes directory, add to BBPATH
BBPATH .= ":${LAYERDIR}"

# We have a packages directory, add to BBFILES
BBFILES += "${LAYERDIR}/recipes-*/*/*.bb \
            "

BBFILES_DYNAMIC += " \
virtualization-layer:${LAYERDIR}/recipes-extended/xen/*.bbappend \
meta-xt-domd-gen4:${LAYERDIR}/recipes-bsp/optee/*.bbappend \
meta-xt-domu-gen4:${LAYERDIR}/recipes-bsp/optee/*.bbappend \
meta-xt-domd-gen4:${LAYERDIR}/recipes-core/util-linux/*.bbappend \
meta-xt-domu-gen4:${LAYERDIR}/recipes-core/util-linux/*.bbappend \
"

PREFERRED_VERSION_optee-client = "4.3.0+renesas+git"

BBFILE_COLLECTIONS += "xt-domx-gen4"
BBFILE_PATTERN_xt-domx-gen4 := "^${LAYERDIR}/"
BBFILE_PRIORITY_xt-domx-gen4 = "12"

LAYERSERIES_COMPAT_xt-domx-gen4 = "scarthgap"
```
